/*LWN 15K*/
/ {
    fragment {
            target-path = "/";
            __overlay__ {

			bat1: battery1 {
				compatible = "simple-battery";
				charge-full-design-microamp-hours = <4831000>;
				charge-term-current-microamp = <240000>;
				constant-charge-voltage-max-microvolt = <4432000>;
				factory-internal-resistance-micro-ohms = <120000>;
				voltage-min-design-microvolt = <3455000>;
				fullbatt-voltage = <4370000>;
				fullbatt-current = <240000>;
				fullbatt-track-end-vol = <4370000>;
				fullbatt-track-end-cur = <260000>;
				first-calib-voltage = <3570000>;
				first-calib-capacity = <40>;

				ocv-capacity-celsius = <20>;
				ocv-capacity-table-0 = <4382000 100>, <4324000 95>, <4266000 90>,
							<4208000 85>, <4151000 80>, <4097000 75>,
							<4048000 70>, <4002000 65>, <3957000 60>,
							<3902000 55>, <3866000 50>, <3841000 45>,
							<3821000 40>, <3804000 35>, <3790000 30>,
							<3770000 25>, <3750000 20>, <3726000 15>,
							<3698000 10>, <3684000 5>, <3400000 0>;
				voltage-temp-table = <1404000 650>, <1307000 700>, <1203000 750>,
							<1095000 800>, <986000 850>, <878000 900>,
							<775000 950>, <678000 1000>, <590000 1050>,
							<510000 1100>, <440000 1150>, <378000 1200>,
							<324000 1250>, <278000 1300>, <238000 1350>,
							<204000 1400>, <175000 1450>, <150000 1500>,
							<129000 1550>, <111000 1600>, <96000 1650>,
							<83000 1700>, <73000 1750>, <63000 1800>,
							<55000 1850>, <48000 1900>, <42000 1950>;
				capacity-temp-table = <45 100>, <25 100>, <10 97>, <0 88>, <(-10) 78>;
				resistance-temp-table = <45 83>, <25 100>, <10 178>, <0 880>, <(-10) 1012>;

				charge-sdp-current-microamp = <650000 500000>;
				charge-dcp-current-microamp = <2200000 2000000>;
				charge-cdp-current-microamp = <1600000 1500000>;
				charge-unknown-current-microamp = <2200000 2000000>;

				dcp-jeita-temp-table = <900 920 0 4432000 0 4180000>,
					<980 1000  950000  4432000 720000 4180000>,
					<1030 1050 2300000 4432000 1200000 4180000>,
					<1100 1120 2300000 4432000 2300000 4432000>,
					<1140 1160 2300000 4432000 2300000 4432000>,
					<1450 1430 2300000 4432000 2300000 4432000>,
					<1530 1510 1200000 4130000 1200000 4130000>;
				sdp-jeita-temp-table = <900 920 0 4432000 0 4180000>,
					<980 1000  650000 4432000 650000 4180000>,
					<1030 1050 650000 4432000 650000 4432000>,
					<1100 1120 650000 4432000 650000 4432000>,
					<1140 1160 650000 4432000 650000 4432000>,
					<1450 1430 650000 4432000 650000 4432000>,
					<1530 1510 650000 4130000 650000 4130000>;
				cdp-jeita-temp-table = <900 920 0 4432000 0 4180000>,
					<980 1000   950000  4432000 720000 4180000>,
					<1030 1050 1600000 4432000 1200000 4180000>,
					<1100 1120 1600000 4432000 1600000 4432000>,
					<1140 1160 1600000 4432000 1600000 4432000>,
					<1450 1430 1600000 4432000 1600000 4432000>,
					<1530 1510 1200000 4130000 1200000 4130000>;
				unknown-jeita-temp-table = <900 920 0 4432000 0 4180000>,
					<980 1000  950000  4432000 720000 4180000>,
					<1030 1050 2300000 4432000 1200000 4180000>,
					<1100 1120 2300000 4432000 2300000 4432000>,
					<1140 1160 2300000 4432000 2300000 4432000>,
					<1450 1430 2300000 4432000 2300000 4432000>,
					<1530 1510 1200000 4130000 1200000 4130000>;
				force-jeita-status = <2>;
			};
        };
    };
};
