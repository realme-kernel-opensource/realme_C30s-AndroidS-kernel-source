## drivers/gpu/drm/sprd/tl_display_private_api/Kconfig
```kconfig
config DRM_SPRD_TL_DISPLAY_PRIVATE_API
	bool CONFIG_DRM_SPRD_TL_DISPLAY_PRIVATE_API
		help
			CONFIG_DRM_SPRD_TL_DISPLAY_PRIVATE_API
```

## drivers/input/touchscreen/icnl9911_milan/Kconfig
```kconfig
config TOUCHSCREEN_CTS
    tristate "Cts Touchscreen"
    help
      Say Y here if you have CTS touch panel.
      If unsure, say N.
      

config TOUCHSCREEN_CHIPONE_MILAN_9911D
	tristate "choice icnl9911d_milan chipset"
	depends on SPI
	help
	  Say Y here if you have a touchscreen using chipe one.
	  To compile this driver as a module, choose M here: the
	  module will be called chipe one.    
```

## drivers/misc/dev_info/Kconfig
```kconfig
config DEVICES_DEV_IFNO
	tristate "config eng mode device info software"
	default n
	help
		define this config to compile device register
```

## drivers/misc/device_info/Kconfig
```kconfig
config OPL_DEVICE_IFNO
	tristate "config opl factory mode device info software"
	help
		define this config to compile device_info.c for device register
```

## drivers/soc/opl/system/tl_phoenix/Kconfig
```kconfig
#Kun.Hu@TECH.BSP.Stability.PHOENIX_PROJECT 2019/06/15, Add for PHOENIX_PROJECT
#change 'y' to 'n', if you want fo close phoenix feature
config OPL_FEATURE_PHOENIX
    tristate "tl phoenix project"
    default y
    help
      define this config to init tl phoenix project.
```
